#include <Arduino.h>
#include "TLE5012.h"

uint8_t J1850CRC8::calc(const uint8_t *buf, int len) {
  const uint8_t *ptr = buf;
  uint8_t reg = 0xff;
  while(len--) reg = table[reg ^ *ptr++];
  return ~reg;
}

const uint8_t J1850CRC8::table[] = {
  0x00, 0x1D, 0x3A, 0x27, 0x74, 0x69, 0x4E, 0x53, 0xE8, 0xF5, 0xD2, 0xCF, 0x9C, 0x81, 0xA6, 0xBB, 
  0xCD, 0xD0, 0xF7, 0xEA, 0xB9, 0xA4, 0x83, 0x9E, 0x25, 0x38, 0x1F, 0x02, 0x51, 0x4C, 0x6B, 0x76, 
  0x87, 0x9A, 0xBD, 0xA0, 0xF3, 0xEE, 0xC9, 0xD4, 0x6F, 0x72, 0x55, 0x48, 0x1B, 0x06, 0x21, 0x3C, 
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  0x7F, 0x62, 0x45, 0x58, 0x0B, 0x16, 0x31, 0x2C, 0x97, 0x8A, 0xAD, 0xB0, 0xE3, 0xFE, 0xD9, 0xC4,
};

TLE5012::TLE5012(int _csq, int _data, int _sck, unsigned char _ssc_delay) : 
  csq_pin(_csq), data_pin(_data), sck_pin(_sck), ssc_delay(_ssc_delay)
{
}

const uint16_t TLE5012::invalidAngle = 0xffff;

void TLE5012::write(uint16_t x) {
  pinMode(data_pin, OUTPUT);
  for(uint8_t i = 0; i < 16; i++) {
    digitalWrite(sck_pin, 1);
    digitalWrite(data_pin, (x & 0x8000) ? 1 : 0);
    if(ssc_delay) delayMicroseconds(ssc_delay);

    digitalWrite(sck_pin, 0);
    x <<= 1;
    if(ssc_delay) delayMicroseconds(ssc_delay);
  }
  pinMode(data_pin, INPUT);
}

uint16_t TLE5012::read() {
  uint16_t x = 0;
  for(uint8_t i = 0; i < 16; i++) {
    digitalWrite(sck_pin, 1);
    x <<= 1;
    if(ssc_delay) delayMicroseconds(ssc_delay);

    digitalWrite(sck_pin, 0);
    x |= digitalRead(data_pin) ? 1 : 0;
    if(ssc_delay) delayMicroseconds(ssc_delay);
  }
  return x;
}

void TLE5012::select() {
  digitalWrite(csq_pin, 0);
  if(ssc_delay) delayMicroseconds(ssc_delay);
}

void TLE5012::deselect() {
  digitalWrite(csq_pin, 1);
}

uint16_t TLE5012::readAngle() {    
  const uint16_t cmdReadAngle = 0x8021;
  uint16_t x, ck;
  select();
  write(cmdReadAngle);
  x = read();
  ck = read();
  deselect();
  /*
  Serial.print(F("ANGLE="));
  Serial.println(x);
  Serial.print(F("SAFETY="));
  Serial.println(ck);
  */
  
  if(ck & 0xf000 != 0xf000) {
    return invalidAngle;
  } else {
    uint8_t buf[] = {
      (uint8_t)(cmdReadAngle >> 8), (uint8_t)cmdReadAngle, 
      (uint8_t)(x >> 8), (uint8_t)x
    };
    uint8_t crc = J1850CRC8::calc(buf, 4);
    uint8_t crc_rx = (uint8_t)ck;
    if(crc != crc_rx) {
      return invalidAngle;
    } else {
      return x & 0x7fff;
    }
  }
}

void TLE5012::begin() {
  pinMode(csq_pin, OUTPUT);
  pinMode(sck_pin, OUTPUT);
}

void TLE5012::end() {
  pinMode(csq_pin, INPUT);
  pinMode(sck_pin, INPUT);
}